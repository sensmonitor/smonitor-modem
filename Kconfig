## Kconfig
```kconfig
menu "SensMonitor modem"

    choice SMONITOR_MODEM_PROFILE
        prompt "Modem profile"
        default SMONITOR_MODEM_PROFILE_SIM7000 if SMONITOR_BOARD_LILYGO_T_SIM7000G
        default SMONITOR_MODEM_PROFILE_SIM7000

        config SMONITOR_MODEM_PROFILE_SIM7000
            bool "SIM7000"
            help
                SIM7000 profile with GPRS, LTE-M, NB-IoT, PSM, eDRX and GNSS
                capabilities. This is the currently implemented and tested
                modem profile.

        config SMONITOR_MODEM_PROFILE_SIM7080
            bool "SIM7080"
            depends on !SMONITOR_BOARD_LILYGO_T_SIM7000G
            help
                SIM7080 profile placeholder. Capability metadata is exposed,
                but model-specific AT initialization is not implemented yet.

        config SMONITOR_MODEM_PROFILE_SIM7600
            bool "SIM7600"
            depends on !SMONITOR_BOARD_LILYGO_T_SIM7000G
            help
                SIM7600 profile placeholder. Capability metadata is exposed,
                but model-specific AT initialization is not implemented yet.
    endchoice

    config SMONITOR_MODEM_LPWA_BAND
        int "Preferred LPWA band"
        default 20
        range 1 85

    config SMONITOR_MODEM_GPS_ENABLE_ANTENNA_POWER
        bool "Enable active GPS antenna power"
        default y
        help
            Sends the SIM7000 AT+SGPIO command used by LilyGO T-SIM7000G
            boards to power the active GPS antenna before reading GNSS data.

    config SMONITOR_MODEM_GPS_INITIAL_DELAY_MS
        int "GPS initial fix wait after GNSS power on"
        default 15000
        range 0 120000

    config SMONITOR_MODEM_GPS_READ_ATTEMPTS
        int "GPS location read attempts"
        default 15
        range 1 60

    config SMONITOR_MODEM_GPS_RETRY_DELAY_MS
        int "GPS retry delay"
        default 15000
        range 1000 120000

endmenu
```
